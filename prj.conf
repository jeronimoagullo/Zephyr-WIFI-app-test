## CMakeLists.txt
```
# SPDX-License-Identifier: Apache-2.0

cmake_minimum_required(VERSION 3.20.0)
find_package(Zephyr REQUIRED HINTS $ENV{ZEPHYR_BASE})
project(jero_wifi_test)

FILE(GLOB app_sources src/*.c)
target_sources(app PRIVATE ${app_sources})
```

## prj.conf
```kconfig
# WIFI
CONFIG_WIFI=y
CONFIG_NETWORKING=y
CONFIG_NET_TCP=y

# Enable DHCPv4 server
CONFIG_NET_DHCPV4=y
CONFIG_NET_MGMT=y
CONFIG_NET_MGMT_EVENT=y

# Enable IPv4 support
CONFIG_NET_IPV4=y
CONFIG_NET_IPV6=n

# Enabling BSD Sockets compatible API
#CONFIG_NET_SOCKETS=y
#CONFIG_NET_SOCKETS_POSIX_NAMES=y
CONFIG_NET_TX_STACK_SIZE=4096
CONFIG_NET_RX_STACK_SIZE=4096


# Enable DNS Resolver
CONFIG_DNS_RESOLVER=y
CONFIG_DNS_SERVER_IP_ADDRESSES=y
CONFIG_DNS_SERVER1="8.8.8.8"

# Log
CONFIG_LOG=y
CONFIG_NET_LOG=y
#CONFIG_NET_L2_ETHERNET_LOG_LEVEL_DBG=y

#CONFIG_NET_SHELL=y

#CONFIG_NET_PKT_RX_COUNT=10
#CONFIG_NET_PKT_TX_COUNT=10
#CONFIG_NET_BUF_RX_COUNT=20
#CONFIG_NET_BUF_TX_COUNT=20
#CONFIG_NET_MAX_CONTEXTS=10

#CONFIG_INIT_STACKS=y
#CONFIG_NET_STATISTICS=y
#CONFIG_NET_STATISTICS_PERIODIC_OUTPUT=n
```

## boards/esp32_devkitc_wrover.conf
```kconfig
### board esp32 ####
CONFIG_HEAP_MEM_POOL_SIZE=98304
CONFIG_NET_L2_ETHERNET=y
CONFIG_ESP32_WIFI_STA_AUTO_DHCPV4=y
```

## src/main.c
```c
/**
 * @file main.c
 * @author Jeronimo Agullo (jeronimo.agullo@sngular.com)
 * @brief It is a WIFI test that just connect to a WIFI
 * it supports Esp32 using the corresponding Kconfig and dts overlay
 * @version 1.0
 * @date 2024-02-15
 * 
 * @copyright Copyright (c) 2022
 * 
 */

#include <zephyr/kernel.h>
#include "jero_wifi.h"

#include <zephyr/logging/log.h>
LOG_MODULE_REGISTER(wifi_test, LOG_LEVEL_DBG);

int main(void)
{
	if (init_wifi()){
		while(1){
			LOG_INF("Now you can use WIFI for your projects! Project by Jeronimo <jeronimoagullo97@gmail.com>");
			k_msleep(10000);
		}
	}
	
	return 0;
}
```

## src/jero_wifi.c
```c
/**
 * @file jero_wifi.c
 * @author Jeronimo Agullo (jeronimoagullo97@gmail.com)
 * @brief 
 * @version 1.0
 * @date 2024-02-15
 * 
 * @copyright Copyright (c) 2024
 * 
 */

#include <zephyr/logging/log.h>
LOG_MODULE_REGISTER(jero_wifi, LOG_LEVEL_DBG);

#include <zephyr/net/net_if.h>
#include <zephyr/net/net_core.h>
#include <zephyr/net/net_context.h>
#include <zephyr/net/net_mgmt.h>
#include <zephyr/net/wifi.h>
#include <zephyr/net/wifi_mgmt.h>
#include "jero_wifi.h"

static struct k_sem net_cb_sem;
static struct net_mgmt_event_callback mgmt_cb;

static void handler(struct net_mgmt_event_callback *cb,
		    uint32_t mgmt_event,
		    struct net_if *iface)
{
	if (mgmt_event != NET_EVENT_IPV4_ADDR_ADD) {
		return;
	}

	for (int i = 0; i < NET_IF_MAX_IPV4_ADDR; i++) {
		char buf[NET_IPV4_ADDR_LEN];

		if (iface->config.ip.ipv4->unicast[i].addr_type !=
							NET_ADDR_DHCP) {
			continue;
		}

		LOG_INF("   Address[%d]: %s", net_if_get_by_iface(iface),
			net_addr_ntop(AF_INET,
			    &iface->config.ip.ipv4->unicast[i].address.in_addr,
						  buf, sizeof(buf)));
		LOG_INF("    Subnet[%d]: %s", net_if_get_by_iface(iface),
			net_addr_ntop(AF_INET,
				       &iface->config.ip.ipv4->netmask,
				       buf, sizeof(buf)));
		LOG_INF("    Router[%d]: %s", net_if_get_by_iface(iface),
			net_addr_ntop(AF_INET,
						 &iface->config.ip.ipv4->gw,
						 buf, sizeof(buf)));
		LOG_INF("Lease time[%d]: %u seconds", net_if_get_by_iface(iface),
			iface->config.dhcpv4.lease_time);
	}

	// Connected
	k_sem_give(&net_cb_sem);
}


bool init_wifi(){
	k_sem_init(&net_cb_sem, 0, 1);

	LOG_INF("STARTING WIFI...");

	struct net_if *iface = net_if_get_default();

	if(iface == NULL){
		LOG_ERR("iface is NULL");
		return false;
	}

	// Check if the net interface if up. If it is not the case, wait for it
	if (net_if_flag_is_set(iface, NET_IF_UP)) {
			LOG_DBG("Net if is already up");
	} else {
		uint32_t raised_event;
		const void *info;
		size_t info_len;

		LOG_INF("Waiting for net if being up");
		int ret = net_mgmt_event_wait_on_iface(net_if_get_default(),
						NET_EVENT_IF_UP, &raised_event, &info,
						&info_len, K_SECONDS(60));

		if (ret != 0) {
			LOG_ERR("Timeout: Net if cannot bring up");
			return false;
		} else {
			LOG_INF("Net if is up");
		}
	}

	net_mgmt_init_event_callback(&mgmt_cb, handler,
				     NET_EVENT_IPV4_ADDR_ADD);

	net_mgmt_add_event_callback(&mgmt_cb);

	static struct wifi_connect_req_params wifi_conn_params;

	// Wifi parameters
	wifi_conn_params.ssid = WIFI_SSID;
	wifi_conn_params.ssid_length = strlen(WIFI_SSID);
	wifi_conn_params.psk  = WIFI_PASSWORD;
	wifi_conn_params.psk_length  = strlen(WIFI_PASSWORD);
	wifi_conn_params.channel = WIFI_CHANNEL_ANY;
	wifi_conn_params.security = WIFI_SECURITY_TYPE_PSK;

	if (net_mgmt(NET_REQUEST_WIFI_CONNECT, iface,
			&wifi_conn_params, sizeof(struct wifi_connect_req_params))) {
		LOG_ERR("Connection failed");
		return false;
	} else {
		LOG_INF("Connection requested...");
		// Wait for connection.....
		k_sem_take(&net_cb_sem, K_FOREVER );
	}

	LOG_INF("Connection successed");

	return true;
}
```

## src/jero_wifi.h
```c
/**
 * @file jero_wifi.h
 * @author Jeronimo Agullo (jeronimoagullo97@gmail.com)
 * @brief 
 * @version 1.0
 * @date 2024-02-15
 * 
 * @copyright Copyright (c) 2024
 * 
 */

#ifndef JERO_WIFI_H
#define JERO_WIFI_H

#define WIFI_SSID		"<your-ssid>"
#define WIFI_PASSWORD	"<your-password>"

bool init_wifi();

#endif /*SNGULAR_WIFI_H*/
```
